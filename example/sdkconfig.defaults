## example/sdkconfig.defaults
```kconfig
CONFIG_ESPTOOLPY_FLASHMODE_QIO=y
CONFIG_ESPTOOLPY_FLASHSIZE_4MB=y
CONFIG_PARTITION_TABLE_CUSTOM=y
CONFIG_WEBAPP_LOCATION="/wifimanager"
CONFIG_DEFAULT_AP_SSID="lssl_ledstrip"
CONFIG_DEFAULT_AP_PASSWORD=""
```
